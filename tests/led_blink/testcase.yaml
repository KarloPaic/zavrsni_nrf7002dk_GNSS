## tests/led_blink/testcase.yaml
```yaml
tests:
  app.led.blink:
    platform_allow: nrf7002dk/nrf5340/cpuapp
    tags: gpio led
    #harness: console
    harness: ztest
    harness_config:
      type: one_line
      regex:
        - "LED toggled"
```

## tests/nmea_parsing/testcase.yaml
```yaml
tests:
  gps.suite:
    platform_allow: nrf7002dk/nrf5340/cpuapp
    tags: gps nmea_parsin
    harness: ztest
    harness_config:
      type: one_line
    
     
```
